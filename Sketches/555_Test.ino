/*******************************************************************************
       This is an example for using the X9Cxxx digital potentiometers
       in a 555 oscillator frequency control situation. By controlling
       the pot and changing the oscillator frequency, tones or sound
       effects can be generated by the 555.

       Using two 555's, a stepped tone generator (Atari punk console) can be configured.

       Note:  For this sketch, the PCB must have U12 and U14 removed (X9C freq. pots)
              and instead, connect physical pots to R5 and R8 

       Hardware project:  https://github.com/GadgetReboot/GR_555_Controller
       Tested on Arduino Uno for I2C control
       Libraries used: PCF8574 https://github.com/RobTillaart/Arduino/tree/master/libraries/PCF8574

       Gadget Reboot

*******************************************************************************/

#include <Wire.h>
#include <PCF8574.h>
#define addr1  0x20    // pcf8574 device 1 I2C address
#define addr2  0x21    // pcf8574 device 2 I2C address

// create pcf8574 controller objects
PCF8574 gpioBank1(addr1);
PCF8574 gpioBank2(addr2);

// pcf8574 GPIO assignment for PCB audio channel and digital pot controls

#define CFG1     0     // 0 = on board resistor between 555 #2 discharge-threshold, 1 = bypass resistor
#define CFG2     1     // 0 = open, 1 = short between 555 #2 threshold-trigger
#define CFG3     2     // 0 = 555 #2 trigger unaffected, 1 = 555 #2 triggered from output of 555 #1
#define CTRL1a   3     // 0 = off, 1 = on  555 #1 main oscillator 
#define CTRL1b   4     // 0 = off, 1 = on  555 #1 sub oscillator 1
#define CTRL1c   5     // 0 = off, 1 = on  555 #1 sub oscillator 2
#define CTRL2a   6     // 0 = off, 1 = on  555 #2 main oscillator 
#define CTRL2b   7     // 0 = off, 1 = on  555 #2 sub oscillator 1

#define CTRL2c   0     // 0 = off, 1 = on  555 #2 sub oscillator 2
#define upDn     1     // 0 = down, 1 = up direction for digital pot increments
#define nINC     2     // advance digital pot wiper in set direction
#define nCS1     3     // chip select digital pot 555 #1 frequency 
#define nCS2     4     // chip select digital pot 555 #1 control voltage
#define nCS3     5     // chip select digital pot 555 #2 frequency
#define nCS4     6     // chip select digital pot 555 #2 control voltage 
#define nCS5     7     // chip select digital pot output level control

void setup() {

  Wire.begin();       // prepare for I2C communication

  // button inputs 
  pinMode(2, INPUT_PULLUP);  // 555 #1 main osc enable
  pinMode(3, INPUT_PULLUP);  // 555 #1 sub osc 1 enable
  pinMode(4, INPUT_PULLUP);  // 555 #1 sub osc 2 enable
  pinMode(5, INPUT_PULLUP);  // 0 = dual 555 stepped tone mode, 1 = single 555 astable mode

  // initialize PCF8574's and disconnect all audio sources from mixer inputs,
  // configure 555 #2 for astable mode, and keep digital pots on standby
  gpioBank1.begin(0x02); // 555 #2 configured as astable osc, all osc outputs disconnected from mixer inputs
  gpioBank2.begin(0xFC); // digital pots on standby,          all osc outputs disconnected from mixer inputs

  // set potentiometer wiper starting positions
  movePotWiperToPos(90, nCS5);    // output level pot
  movePotWiperToPos(50, nCS2);    // 555 #1 cv pot
  movePotWiperToPos(50, nCS4);    // 555 #2 cv pot

}

void loop() {

  // if button is pressed, enter dual 555 stepped tone mode
  if (!digitalRead(5))
  {
    stepped_tone();                  // configure 555's for stepped tone mode
    gpioBank1.write(CTRL1a, LOW);    // disable 555 #1 main osc audio output
    gpioBank1.write(CTRL2a, HIGH);   // enable 555 #2 main osc audio output
    while (!digitalRead(5))          // stay in this mode until gpio goes high
    {}
    gpioBank1.write(CTRL2a, LOW);    // disable 555 #2 main osc audio output
    astable();                       // switch back to astable mode with audio on 555 #1
  }

  // as long as a button is pressed, enable 555 #1 audio output(s)
  if (!digitalRead(2))
    gpioBank1.write(CTRL1a, HIGH);
  else
    gpioBank1.write(CTRL1a, LOW);

  if (!digitalRead(3))
    gpioBank1.write(CTRL1b, HIGH);
  else
    gpioBank1.write(CTRL1b, LOW);

  if (!digitalRead(4))
    gpioBank1.write(CTRL1c, HIGH);
  else
    gpioBank1.write(CTRL1c, LOW);
}

/*---------------------------------------- 555 config functions -------------------------------*/

// configure 555's for stepped tone mode
void stepped_tone()
{

  // configure 555 #2 for monostable mode, triggered by 555 #1 output
  gpioBank1.write(CFG1, HIGH);  // 555 #2 short discharge to threshold
  gpioBank1.write(CFG2, LOW);   // 555 #2 threshold disconnected from trigger
  gpioBank1.write(CFG3, HIGH);  // 555 #1 output to 555 #2 trigger

}

void astable()
{

  // configure 555 #2 for astable mode and disconnect from 555 #1
  gpioBank1.write(CFG1, LOW);
  gpioBank1.write(CFG2, HIGH);
  gpioBank1.write(CFG3, LOW);

}


/*---------------------------------------- digital pot functions -------------------------------*/

// move a selected potentiometer's wiper a number of steps up or down
void movePotWiper(int steps, byte dir, byte nCS)
{
  int i = (steps > 99) ? 99 : steps;       // must move wiper at least 1 step and no more than 99 steps
  if (i < 1) return;

  gpioBank2.write(upDn, dir);              // set increment direction
  gpioBank2.write(nCS, LOW);               // select target pot
  delayMicroseconds(1);                    // delay >=100nS between nCS and nINC
  while (i--) {
    gpioBank2.write(nINC, LOW);            // move wiper by requested # of steps
    delayMicroseconds(1);                  // nINC must hold state >=1uS
    gpioBank2.write(nINC, HIGH);
    delayMicroseconds(1);
  }
  delayMicroseconds(100);                  // delay >=100uS for wiper to change position

  gpioBank2.write(nINC, LOW);
  delayMicroseconds(1);
  gpioBank2.write(nCS, HIGH);              // de-select chip without saving wiper position in nvm
  delayMicroseconds(1);
  gpioBank2.write(nINC, HIGH);
}

// move a pot's wiper to a specific position from 0-99
// first move the pot all the way to one end, then count steps to target position
// there is no way to read the wiper position
void movePotWiperToPos(int pos, byte nCS)
{
  int i = (pos > 99) ? 99 : pos;           // wiper position can be 0 to 99
  if (i < 0) i = 0;

  movePotWiper(99, 0, nCS);                // move wiper to a known position (end of travel at low terminal)
  movePotWiper(pos, 1, nCS);               // move wiper to intended position from 0-99
}

// move a pot's wiper by a specific number of steps in a certain direction
// this is a relative move, useful when an adjustment is required
// without moving the wiper all the way to one end and back
void trimPotWiper(int steps, byte dir, byte nCS)
{
  int i = (steps > 99) ? 99 : steps;       // wiper can move 1 to 99 steps
  if (i < 1) return;

  movePotWiper(steps, dir, nCS);           // move wiper requested number of steps/direction
}
